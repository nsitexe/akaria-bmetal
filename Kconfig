## Kconfig
```kconfig
# SPDX-License-Identifier: Apache-2.0

mainmenu "Baremetal CRT configuration"

source "arch/Kconfig"
source "board/Kconfig"
source "driver/Kconfig"
```

## arch/Kconfig
```kconfig
# SPDX-License-Identifier: Apache-2.0

menu "Archtecture dependent options"

source "arch/$(ARCH)/Kconfig"

choice
	prompt "Word size"

	config 32BIT
		bool "32bit"
	config 64BIT
		bool "64bit"
endchoice

config ATOMIC
	bool "Atomic operations support"

config CACHE
	bool "Cache management support"

config FPU
	bool "FPU support"

config FPU_DOUBLE
	bool "Double precision FPU support"
	depends on FPU

config VPU
	bool "Vector support"

config XIP
	bool "Execution in place (XIP) support"

config CLEAR_BSS
	bool "Clear BSS area at booting"

config MIRROR_RAM
	bool "Mirror RAM area support"

config MAIN_CORE
	int "ID of main CPU"
	default 0

config NUM_CORES
	int "Maximum number of CPUs"
	default 4

endmenu
```

## arch/riscv/Kconfig
```kconfig
# SPDX-License-Identifier: Apache-2.0

config RISCV
	def_bool y

config RISCV_EXT_I_OLD
	bool "RISC-V integer (binutils < 2.38)"

config RISCV_EXT_I
	bool "RISC-V integer with Zicsr and Zifencei (binutils >= 2.38)"

config RISCV_EXT_M
	bool "RISC-V multiplication and division"

config RISCV_EXT_A
	bool "RISC-V atomic"
	depends on ATOMIC

config RISCV_EXT_F
	bool "RISC-V single-precision floating-point"
	depends on FPU

config RISCV_EXT_D
	bool "RISC-V double-precision floating-Point"
	depends on FPU_DOUBLE

config RISCV_EXT_C
	bool "RISC-V compressed"

config RISCV_EXT_V
	bool "RISC-V vector operations"

config RISCV_EXT_ZBA
	bool "RISC-V address generation"

config RISCV_EXT_ZBB
	bool "RISC-V basic bit-manipulation"

config RISCV_EXT_ZBC
	bool "RISC-V carry-less multiplication"

config RISCV_EXT_ZBS
	bool "RISC-V single-bit"

config RISCV_EXT_ZICBOM
	bool "RISC-V cache-block management"
	depends on CACHE

config RISCV_EXT_ZICBOZ
	bool "RISC-V cache-block zero"
	depends on CACHE

config RISCV_EXT_ZICBOP
	bool "RISC-V cache-block prefetch"
	depends on CACHE
```

## cmake/kconfig.cmake
```kconfig
# SPDX-License-Identifier: Apache-2.0

# Check variables
if(NOT DEFINED CONF_DIR)
  message(FATAL_ERROR "CONF_DIR is not defined.")
endif()
if(NOT DEFINED PRJ_CONFIG_NAME)
  message(FATAL_ERROR "PRJ_CONFIG_NAME is not defined.")
endif()
if(NOT DEFINED PRJ_CONFIG_CACHE_NAME)
  message(FATAL_ERROR "PRJ_CONFIG_CACHE_NAME is not defined.")
endif()
if(NOT DEFINED PRJ_CONFIG_NOTIFY_NAME)
  message(FATAL_ERROR "PRJ_CONFIG_NOTIFY_NAME is not defined.")
endif()
if(NOT DEFINED PRJ_AUTOCONF_H_DIR)
  message(FATAL_ERROR "PRJ_AUTOCONF_H_DIR is not defined.")
endif()
if(NOT DEFINED PRJ_AUTOCONF_H_NAME)
  message(FATAL_ERROR "PRJ_AUTOCONF_H_NAME is not defined.")
endif()

# Import Kconfig-like config variables to cmake environment
# from a specified config file.
#
# Comment:
#   Start with '#' character.
# Config:
#   Start with CONFIG_ prefix. Cannot use '=' for config name.
# Value:
#   Enable to use bool (y is defined, n is not defined), number
#   and string. Value is placed after '=' character.
#
# Example:
#   CONFIG_AAA=y
#   CONFIG_BBB=n
#   CONFIG_CCC=100
#   CONFIG_DDD="string"
function(import_config config_file)
  # Remove comments
  file(
    STRINGS
    ${config_file}
    CONFIG_LIST
    REGEX "^CONFIG_"
  )

  foreach(CONFIG ${CONFIG_LIST})
    # Separate name and value
    string(REGEX MATCH "[^=]+" CONFIG_NAME ${CONFIG})
    string(REGEX REPLACE "[^=]+=" "" CONFIG_VAL ${CONFIG})

    # Remove quotation marks
    string(REGEX REPLACE "^\"" "" CONFIG_VAL ${CONFIG_VAL})
    string(REGEX REPLACE "\"$" "" CONFIG_VAL ${CONFIG_VAL})

    set(${CONFIG_NAME} ${CONFIG_VAL} PARENT_SCOPE)
  endforeach()
endfunction()

# [Tentative]
# Write autoconf.h from a specified config file.
#
# A config macro is ...:
#   - defined as 1 if the config has boolean value 'y'.
#   - not defined if the config boolean value 'n'.
#   - defined as number if the config has numerical value.
#   - defined as string if the config has string value.
function(write_autoconf config_file autoconf_file)
  # Remove comments
  file(
    STRINGS
    ${config_file}
    CONFIG_LIST
    REGEX "^CONFIG_"
  )

  # Clear output file
  file(
    WRITE
    ${autoconf_file}
    ""
  )

  foreach(CONFIG ${CONFIG_LIST})
    # Separate name and value
    string(REGEX MATCH "[^=]+" CONFIG_NAME ${CONFIG})
    string(REGEX REPLACE "[^=]+=" "" CONFIG_VAL ${CONFIG})

    if(${CONFIG_VAL} STREQUAL "n")
      continue()
    endif()
    if(${CONFIG_VAL} STREQUAL "y")
      set(CONFIG_VAL 1)
    endif()

    file(
      APPEND
      ${autoconf_file}
      "#define ${CONFIG_NAME} ${CONFIG_VAL}\n"
    )
  endforeach()
endfunction()

# file(COPY_FILE ...) for old cmake
function(file_copy_file SRC_FILE DEST_FILE)
  file(READ ${SRC_FILE} VAR_TMP)
  file(WRITE ${DEST_FILE} ${VAR_TMP})
endfunction()

# File path for Kconfig
set(PRJ_DEFCONF_FILE ${CONF_DIR}/${DEFCONF})
set(PRJ_CONFIG_FILE ${PROJECT_BINARY_DIR}/${PRJ_CONFIG_NAME})
set(PRJ_CONFIG_CACHE_FILE ${PROJECT_BINARY_DIR}/${PRJ_CONFIG_CACHE_NAME})
set(PRJ_CONFIG_NOTIFY_FILE ${PROJECT_BINARY_DIR}/${PRJ_CONFIG_NOTIFY_NAME})
set(PRJ_AUTOCONF_H_FILE ${PROJECT_BINARY_DIR}/${PRJ_AUTOCONF_H_DIR}/${PRJ_AUTOCONF_H_NAME})

# Target: Default config
# TODO: Use suitable tools for Kconfig
add_custom_target(
  defconfig
  COMMAND cp ${PRJ_DEFCONF_FILE} ${PRJ_CONFIG_FILE}
  COMMAND touch ${PRJ_CONFIG_NOTIFY_FILE}
  )

# Target: Config
# TODO: Use suitable tools for Kconfig
add_custom_target(
  config
  COMMAND touch ${PRJ_CONFIG_NOTIFY_FILE}
  )

# Run defconfig silently and create cache if each file does not exist
# TODO: Use suitable tools for Kconfig
if(NOT EXISTS ${PRJ_CONFIG_FILE})
  if(NOT EXISTS ${PRJ_DEFCONF_FILE} OR IS_DIRECTORY ${PRJ_DEFCONF_FILE})
    message(FATAL_ERROR "defconf '${PRJ_DEFCONF_FILE}' is wrong. Please set DEFCONF.")
  endif()
  file_copy_file(${PRJ_DEFCONF_FILE} ${PRJ_CONFIG_FILE})
  file_copy_file(${PRJ_DEFCONF_FILE} ${PRJ_CONFIG_CACHE_FILE})
endif()
file_copy_file(${PRJ_CONFIG_FILE} ${PRJ_CONFIG_CACHE_FILE})
file(WRITE ${PRJ_CONFIG_NOTIFY_FILE} "")
include(${PRJ_CONFIG_NOTIFY_FILE})

# Target: Cache of config
# If config is changed, run cmake again.
add_custom_target(
  cache_config
  COMMAND
    ${CMAKE_COMMAND} -E compare_files
      "${PRJ_CONFIG_FILE}" "${PRJ_CONFIG_CACHE_FILE}" ";"
    if [ $$? -ne 0 ]; then
      ${CMAKE_COMMAND} -E copy
        ${PRJ_CONFIG_FILE} ${PRJ_CONFIG_CACHE_FILE} ";"
      ${CMAKE_COMMAND} -E touch
        ${PRJ_CONFIG_NOTIFY_FILE} ";"
      ${CMAKE_MAKE_PROGRAM} ";"
    fi
  )
add_dependencies(${PRJ_LIB_NAME} cache_config)

# Import configs
# After that, we can use CONFIG_ABCD variables in CMake
import_config(${PRJ_CONFIG_FILE})

### TODO: config and autoconf.h should be generated by suitable tools
write_autoconf(${PRJ_CONFIG_FILE} ${PRJ_AUTOCONF_H_FILE})
```

## driver/Kconfig
```kconfig
# SPDX-License-Identifier: Apache-2.0

menu "Device Drivers"

source "driver/clk/Kconfig"
source "driver/cpu/Kconfig"
source "driver/intc/Kconfig"
source "driver/reset/Kconfig"
source "driver/timer/Kconfig"
source "driver/uart/Kconfig"

endmenu
```

## driver/cpu/Kconfig
```kconfig
# SPDX-License-Identifier: Apache-2.0

menu "Architecture dependent drivers"

endmenu
```

## driver/intc/Kconfig
```kconfig
# SPDX-License-Identifier: Apache-2.0

menu "Interrupt controller drivers"

config INTC
	bool "Interrupt controller drivers"
	help
	  Interrupt controller drivers

if INTC

config INTC_RISCV_PRIV
	bool "RISC-V priviledged arch"

config INTC_SIFIVE_CLINT
	bool "SiFive CLINT"

config INTC_SIFIVE_PLIC
	bool "SiFive PLIC"

endif # INTC

endmenu
```

## driver/reset/Kconfig
```kconfig
# SPDX-License-Identifier: Apache-2.0

menu "Reset controller drivers"

config RESET
	bool "Reset controller drivers"
	help
	  Reset controller drivers

if RESET

config RESET_SIFIVE_QEMU_TEST
	bool "SiFive QEMU reset driver"

endif # RESET

endmenu
```

## driver/timer/Kconfig
```kconfig
# SPDX-License-Identifier: Apache-2.0

menu "Timer drivers"

config TIMER
	bool "Timer drivers"
	help
	  Timer drivers

if TIMER

config TIMER_NSITEXE_ICU_TIMER
	bool "NSITEXE ICU timer"

config TIMER_SIFIVE_CLINT_TIMER
	bool "SiFive CLINT timer"

endif # TIMER

endmenu
```

## driver/uart/Kconfig
```kconfig
# SPDX-License-Identifier: Apache-2.0

menu "Serial drivers"

config UART
	bool "Usyncronous drivers"
	help
	  Serial drivers

if UART

config UART_NS16550
	bool "NS16550"

config UART_SIFIVE
	bool "SiFive UART"

config UART_XILINX_UART_LITE
	bool "Xilinx UART lite"

endif # UART

endmenu
```

## drivers/clk/Kconfig
```kconfig
# SPDX-License-Identifier: Apache-2.0

menu "Clock drivers"

config CLK
	bool "Clock drivers"
	help
	  Clock drivers

if CLK

config CLK_SIFIVE_PRCI
	bool "SiFive PRCI"

endif # CLK

endmenu
```
